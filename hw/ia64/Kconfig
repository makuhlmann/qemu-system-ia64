## hw/ia64/Kconfig
```kconfig
config IA64_VPC
    bool
    depends on IA64
    select GENERIC_LOADER
    select SERIAL_MM
    select PCI
    select HP_SBA_IOMMU
    select OR_IRQ
    select ISA_BUS
    select PFLASH_CFI01
    select MC146818RTC
    select I8259
    select I8254
    select ACPI
    imply IA64_VPC_AUDIO
    imply IA64_VPC_GRAPHICS
    imply IA64_VPC_NETWORK
    imply IA64_VPC_PS2
    imply IA64_VPC_STORAGE
    imply IA64_VPC_USB

config IA64_VPC_AUDIO
    bool
    depends on IA64_VPC
    select CS4281

config IA64_VPC_GRAPHICS
    bool
    depends on IA64_VPC
    select ATI_VGA
    select MACH64_VGA
    select NV15_VGA
    select VGA_PCI

config IA64_VPC_NETWORK
    bool
    depends on IA64_VPC
    select E1000_PCI
    select EEPRO100_PCI

config IA64_VPC_PS2
    bool
    depends on IA64_VPC
    select PCKBD

config IA64_VPC_STORAGE
    bool
    depends on IA64_VPC
    select AHCI_ICH9
    select IDE_CMD646
    select LSI_SCSI_PCI

config IA64_VPC_USB
    bool
    depends on IA64_VPC
    select USB_HID
    select USB_OHCI_PCI
    select USB_UHCI
```
